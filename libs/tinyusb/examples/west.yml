## libs/tinyusb/examples/west.yml
```yaml
manifest:
  
  defaults:
    remote: alif

  remotes:
    - name: alif
      url-base: https://github.com/AlifSemi-Sirin
  
  projects:
    - name: zephyr
      repo-path: zephyr_alif_fork_4.1.git
      revision: zas-v2.x-dev-mr
      import: true
  self:
    path: .
```
